## CMakeLists.txt
```
cmake_minimum_required(VERSION 3.20)
if(NOT ROS2_ZEPHYR_DIR OR NOT APP_PEER_IP OR NOT APP_CREDENTIALS_DIR)
  message(FATAL_ERROR "Set ROS2_ZEPHYR_DIR, APP_PEER_IP and APP_CREDENTIALS_DIR")
endif()
include("${ROS2_ZEPHYR_DIR}/cmake/deployment.cmake")
ros2_zephyr_compile_deployment("${CMAKE_CURRENT_LIST_DIR}/deployment.json")
list(APPEND ZEPHYR_EXTRA_MODULES "${ROS2_ZEPHYR_DIR}")
list(APPEND EXTRA_CONF_FILE "${CMAKE_CURRENT_LIST_DIR}/network.conf")
include("${ROS2_ZEPHYR_DIR}/profiles/esp32c6-a4.cmake")
set(ROS2_ZEPHYR_CYCLONEDDS_URI
  "<CycloneDDS><Domain><General><AllowMulticast>false</AllowMulticast><MaxMessageSize>1400B</MaxMessageSize></General><Sizing><ReceiveBufferSize>8KiB</ReceiveBufferSize><ReceiveBufferChunkSize>4KiB</ReceiveBufferChunkSize></Sizing><Discovery><ParticipantIndex>0</ParticipantIndex><MaxAutoParticipantIndex>1</MaxAutoParticipantIndex><Peers><Peer Address='${APP_PEER_IP}'/></Peers></Discovery><Internal><MultipleReceiveThreads>false</MultipleReceiveThreads></Internal></Domain></CycloneDDS>"
  CACHE STRING "Fixed direct-DDS peer" FORCE)
# UInt32 uses the pinned RMW's existing standard-message adapter.
set(ROS2_ZEPHYR_EXTRA_PACKAGES "" CACHE STRING "Additional fixed-size message packages")
find_package(Zephyr REQUIRED HINTS $ENV{ZEPHYR_BASE})
project(c6_pubsub C CXX)
target_sources(app PRIVATE src/main.c src/wifi.c)
target_include_directories(app PRIVATE src "${APP_CREDENTIALS_DIR}")
ros2_zephyr_add_generated_deployment(app)
target_compile_options(app PRIVATE -Wall -Wextra -Werror)
```

## Kconfig
```
mainmenu "ESP32-C6 ROS 2 pub/sub"
source "Kconfig.zephyr"
```

## prj.conf
```kconfig
CONFIG_ROS2_ZEPHYR=y
CONFIG_ROS2_ZEPHYR_DOMAIN_ID=73
CONFIG_CPP=y
CONFIG_POSIX_API=y
CONFIG_POSIX_THREADS=y
CONFIG_POSIX_THREAD_THREADS_MAX=8
CONFIG_POSIX_THREAD_KEYS_MAX=8
CONFIG_POSIX_THREAD_ATTR_STACKSIZE=y
CONFIG_POSIX_THREADS_EXT=y
CONFIG_POSIX_THREAD_PRIORITY_SCHEDULING=y
CONFIG_POSIX_PRIORITY_SCHEDULING=y
CONFIG_STATIC_INIT_GNU=y
CONFIG_NET_IPV4_IGMP=y
CONFIG_NET_IF_MCAST_IPV4_ADDR_COUNT=4
CONFIG_THREAD_NAME=y
CONFIG_THREAD_STACK_INFO=y
CONFIG_INIT_STACKS=y
```

## network.conf
```kconfig
# Networking baseline; edits require fresh resource admission and hardware checks.
CONFIG_SIZE_OPTIMIZATIONS=y
CONFIG_PICOLIBC=y
CONFIG_PICOLIBC_USE_MODULE=y
CONFIG_THREAD_LOCAL_STORAGE=y
CONFIG_NETWORKING=y
CONFIG_NET_IPV4=y
CONFIG_NET_IPV6=n
CONFIG_NET_UDP=y
CONFIG_NET_TCP=y
CONFIG_NET_SOCKETS=y
CONFIG_NET_DHCPV4=y
CONFIG_NET_CONFIG_SETTINGS=y
CONFIG_NET_CONFIG_NEED_IPV4=y
CONFIG_NET_MAX_CONTEXTS=12
CONFIG_NET_MAX_CONN=12
CONFIG_NET_SOCKETS_POLL_MAX=8
CONFIG_NET_PKT_RX_COUNT=8
CONFIG_NET_PKT_TX_COUNT=4
CONFIG_NET_BUF_RX_COUNT=32
CONFIG_NET_BUF_TX_COUNT=8
CONFIG_NET_BUF_DATA_SIZE=256
CONFIG_NET_IPV4_MTU=1500
CONFIG_WIFI=y
CONFIG_ESP32_WIFI_STA_AUTO_DHCPV4=y
CONFIG_ESP32_WIFI_STA_RECONNECT=y
CONFIG_ESP32_WIFI_STATIC_RX_BUFFER_NUM=2
CONFIG_ESP32_WIFI_DYNAMIC_RX_BUFFER_NUM=8
CONFIG_ESP32_WIFI_DYNAMIC_TX_BUFFER=y
CONFIG_ESP32_WIFI_DYNAMIC_TX_BUFFER_NUM=16
CONFIG_ESP32_WIFI_RX_BA_WIN=4
CONFIG_ENTROPY_GENERATOR=y
CONFIG_PRINTK=y
CONFIG_LOG=y
CONFIG_LOG_DEFAULT_LEVEL=2
```

## src/main.c
```c
// SPDX-License-Identifier: Apache-2.0
#include "generated_ros_init.h"
#include "wifi.h"
#include <rcl/error_handling.h>
#include <rcl/rcl.h>
#include <rclc/executor.h>
#include <rclc/rclc.h>
#include <ros2_zephyr/allocator.h>
#include <std_msgs/msg/u_int32.h>
#include <zephyr/kernel.h>

static ros2z_deployment_context_t deployment;
static bool publish_failed;

// Edit this callback to consume a command and publish a fixed-size state.
// No GPIO, motor-control timing or stale-command guarantee is implied.
void subscription_callback(const void *message)
{
  const std_msgs__msg__UInt32 *command = message;
  std_msgs__msg__UInt32 state = {.data = command->data};
  if (rcl_publish(&deployment.publisher_outgoing, &state, NULL) != RCL_RET_OK) {
    publish_failed = true;
  }
}

int main(void)
{
  int status = app_wifi_connect();
  if (status) {
    printk("C6_APP_WIFI_FAIL code=%d\n", status);
    return status;
  }
  rcl_allocator_t allocator = {
      .allocate = ros2_zephyr_allocate,
      .deallocate = ros2_zephyr_deallocate,
      .reallocate = ros2_zephyr_reallocate,
      .zero_allocate = ros2_zephyr_zero_allocate,
      .state = ros2_zephyr_allocator_state(ROS2_ZEPHYR_ALLOCATION_ROS),
  };
  rclc_support_t support = {0};
  if (rclc_support_init(&support, 0, NULL, &allocator) != RCL_RET_OK) {
    printk("C6_APP_SUPPORT_FAIL\n");
    return 1;
  }
  if (ros2z_deployment_init(&deployment, &support, &allocator) != RCL_RET_OK) {
    printk("C6_APP_DEPLOYMENT_FAIL\n");
    (void)rclc_support_fini(&support);
    return 1;
  }
  printk("C6_APP_READY domain=73 command=/c6/command state=/c6/state\n");
  for (;;) {
    rcl_ret_t rc = rclc_executor_spin_some(&deployment.executor, RCL_MS_TO_NS(100));
    if ((rc != RCL_RET_OK && rc != RCL_RET_TIMEOUT) || publish_failed) {
      printk("C6_APP_FAIL code=%d publish_failed=%d\n", (int)rc, publish_failed);
      break;
    }
  }
  (void)ros2z_deployment_fini(&deployment);
  (void)rclc_support_fini(&support);
  return 1;
}
```

## src/wifi.c
```c
// SPDX-License-Identifier: Apache-2.0
#include "wifi.h"
#include "wifi_credentials.h"
#include <errno.h>
#include <string.h>
#include <zephyr/kernel.h>
#include <zephyr/net/net_event.h>
#include <zephyr/net/net_if.h>
#include <zephyr/net/net_ip.h>
#include <zephyr/net/net_mgmt.h>
#include <zephyr/net/wifi_mgmt.h>
static K_SEM_DEFINE(connected, 0, 1);
static K_SEM_DEFINE(address_ready, 0, 1);
static struct net_mgmt_event_callback wifi_cb, ip_cb;
static void wifi_event(struct net_mgmt_event_callback *cb, uint64_t event, struct net_if *iface)
{
  ARG_UNUSED(iface);
  if (event == NET_EVENT_WIFI_CONNECT_RESULT) {
    const struct wifi_status *s = cb->info;
    if (s && s->status == 0)
      k_sem_give(&connected);
    else
      printk("APP_WIFI_CONNECT_ERROR %d\n", s ? s->status : -1);
  }
}
static void ip_event(struct net_mgmt_event_callback *cb, uint64_t event, struct net_if *iface)
{
  ARG_UNUSED(cb);
  ARG_UNUSED(iface);
  if (event == NET_EVENT_IPV4_ADDR_ADD)
    k_sem_give(&address_ready);
}
int app_wifi_connect(void)
{
  struct net_if *iface = net_if_get_default();
  if (!iface)
    return -ENODEV;
  net_mgmt_init_event_callback(&wifi_cb, wifi_event, NET_EVENT_WIFI_CONNECT_RESULT);
  net_mgmt_init_event_callback(&ip_cb, ip_event, NET_EVENT_IPV4_ADDR_ADD);
  net_mgmt_add_event_callback(&wifi_cb);
  net_mgmt_add_event_callback(&ip_cb);
  struct wifi_connect_req_params params = {
      .ssid = (const uint8_t *)APP_WIFI_SSID,
      .ssid_length = sizeof(APP_WIFI_SSID) - 1,
      .psk = (const uint8_t *)APP_WIFI_PSK,
      .psk_length = sizeof(APP_WIFI_PSK) - 1,
      .channel = WIFI_CHANNEL_ANY,
      .security = WIFI_SECURITY_TYPE_PSK,
  };
  int rc = net_mgmt(NET_REQUEST_WIFI_CONNECT, iface, &params, sizeof(params));
  if (rc)
    return rc;
  if (k_sem_take(&connected, K_SECONDS(30)) || k_sem_take(&address_ready, K_SECONDS(30)))
    return -ETIMEDOUT;
  struct wifi_ps_params ps = {.enabled = WIFI_PS_DISABLED, .type = WIFI_PS_PARAM_STATE};
  rc = net_mgmt(NET_REQUEST_WIFI_PS, iface, &ps, sizeof(ps));
  if (rc)
    return rc; // Keep the reference profile reproducible.
  const struct net_in_addr *ip = net_if_ipv4_get_global_addr(iface, NET_ADDR_PREFERRED);
  char address[NET_IPV4_ADDR_LEN];
  if (!ip || !net_addr_ntop(NET_AF_INET, ip, address, sizeof(address)))
    return -EADDRNOTAVAIL;
  struct wifi_iface_status status = {0};
  rc = net_mgmt(NET_REQUEST_WIFI_IFACE_STATUS, iface, &status, sizeof(status));
  printk("APP_WIFI_READY ip=%s power_save=disabled status_rc=%d rssi=%d channel=%u\n", address, rc,
         status.rssi, status.channel);
  return 0;
}
```

## src/wifi.h
```c
// SPDX-License-Identifier: Apache-2.0
#pragma once

int app_wifi_connect(void);
```
