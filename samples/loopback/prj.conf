## CMakeLists.txt
```
# SPDX-License-Identifier: Apache-2.0

cmake_minimum_required(VERSION 3.20.0)

include("${CMAKE_CURRENT_SOURCE_DIR}/../../cmake/deployment.cmake")
ros2_zephyr_compile_deployment("${CMAKE_CURRENT_SOURCE_DIR}/deployment.json")

list(APPEND ZEPHYR_EXTRA_MODULES "${CMAKE_CURRENT_SOURCE_DIR}/../..")
find_package(Zephyr REQUIRED HINTS $ENV{ZEPHYR_BASE})
project(ros2_zephyr_loopback C CXX)

target_sources(app PRIVATE src/main.c)
ros2_zephyr_add_generated_deployment(app)
target_compile_options(app PRIVATE -Wall -Wextra -Werror)
```

## prj.conf
```kconfig
# SPDX-License-Identifier: Apache-2.0

CONFIG_ROS2_ZEPHYR=y
CONFIG_ROS2_ZEPHYR_DOMAIN_ID=95

CONFIG_CPP=y
CONFIG_PICOLIBC=y
CONFIG_PICOLIBC_USE_MODULE=y
CONFIG_PICOLIBC_IO_LONG_LONG=y

# Native simulation previously reserved desktop-sized fallback values.  The
# loopback high-water mark is below 86 KiB; keep a 3x libc arena margin.
CONFIG_ROS2_ZEPHYR_CYCLONEDDS_THREAD_STACK_SIZE=8192
CONFIG_MAIN_STACK_SIZE=16384
CONFIG_HEAP_MEM_POOL_SIZE=131072
CONFIG_COMMON_LIBC_MALLOC_ARENA_SIZE=262144
CONFIG_IDLE_STACK_SIZE=1024
CONFIG_SYSTEM_WORKQUEUE_STACK_SIZE=2048
CONFIG_THREAD_NAME=y
CONFIG_THREAD_MONITOR=y
CONFIG_THREAD_STACK_INFO=y
CONFIG_INIT_STACKS=y

CONFIG_POSIX_API=y
CONFIG_POSIX_THREADS=y
CONFIG_POSIX_THREAD_THREADS_MAX=10
CONFIG_MAX_PTHREAD_MUTEX_COUNT=300
CONFIG_MAX_PTHREAD_COND_COUNT=150
CONFIG_POSIX_THREAD_KEYS_MAX=32
CONFIG_POSIX_THREAD_ATTR_STACKSIZE=y
CONFIG_POSIX_THREADS_EXT=y
CONFIG_POSIX_THREAD_PRIORITY_SCHEDULING=y
CONFIG_STATIC_INIT_GNU=y

CONFIG_NETWORKING=y
CONFIG_NET_IPV4=y
CONFIG_NET_IPV6=n
CONFIG_NET_UDP=y
CONFIG_NET_SOCKETS=y
CONFIG_NET_CONFIG_SETTINGS=y
CONFIG_NET_CONFIG_NEED_IPV4=y
CONFIG_NET_CONFIG_MY_IPV4_ADDR="127.0.0.1"
CONFIG_NET_CONFIG_PEER_IPV4_ADDR="127.0.0.1"
CONFIG_NET_CONFIG_MY_IPV4_GW=""
CONFIG_NET_CONFIG_MY_IPV4_NETMASK="255.0.0.0"
CONFIG_NET_DRIVERS=y
CONFIG_NET_LOOPBACK=y
CONFIG_NET_L2_DUMMY=y
CONFIG_ETH_NATIVE_TAP=n
CONFIG_NET_PKT_RX_COUNT=8
CONFIG_NET_PKT_TX_COUNT=8
CONFIG_NET_BUF_RX_COUNT=16
CONFIG_NET_BUF_TX_COUNT=16
CONFIG_NET_BUF_DATA_SIZE=512
CONFIG_NET_CONTEXT_NET_PKT_POOL=y
CONFIG_NET_MAX_CONTEXTS=16
CONFIG_NET_SOCKETS_POLL_MAX=16
CONFIG_NET_IF_MCAST_IPV4_ADDR_COUNT=8

CONFIG_ENTROPY_GENERATOR=y
CONFIG_TEST_RANDOM_GENERATOR=y
CONFIG_LOG=y
CONFIG_LOG_MODE_IMMEDIATE=y
CONFIG_PRINTK=y
```

## prj_esp32.conf
```kconfig
# SPDX-License-Identifier: Apache-2.0

CONFIG_ROS2_ZEPHYR=y
CONFIG_ROS2_ZEPHYR_DOMAIN_ID=95
CONFIG_ROS2_ZEPHYR_CYCLONEDDS_THREAD_COUNT=5
# This sample has only an on-board loopback peer. External discovery uses the
# module's larger default unless an application supplies its own measurement.
# Measured worst case for this loopback is the event thread at 3408 bytes used.
CONFIG_ROS2_ZEPHYR_CYCLONEDDS_THREAD_STACK_SIZE=4864

CONFIG_CPP=y
CONFIG_PICOLIBC=y
CONFIG_PICOLIBC_USE_MODULE=y
CONFIG_PICOLIBC_IO_LONG_LONG=y

# The complete rclc lifecycle used 6848 bytes on ESP32; retain 5 KiB margin.
CONFIG_MAIN_STACK_SIZE=12288
CONFIG_HEAP_MEM_POOL_SIZE=32768
CONFIG_COMMON_LIBC_MALLOC_ARENA_SIZE=-1
CONFIG_IDLE_STACK_SIZE=1024
CONFIG_SYSTEM_WORKQUEUE_STACK_SIZE=2048
CONFIG_THREAD_NAME=y
CONFIG_THREAD_MONITOR=y
CONFIG_THREAD_STACK_INFO=y
CONFIG_INIT_STACKS=y

CONFIG_POSIX_API=y
CONFIG_POSIX_THREADS=y
CONFIG_POSIX_THREAD_THREADS_MAX=8
# Loopback-only measured profile; not sufficient for external DDS discovery.
CONFIG_MAX_PTHREAD_MUTEX_COUNT=160
CONFIG_MAX_PTHREAD_COND_COUNT=96
CONFIG_POSIX_THREAD_KEYS_MAX=8
CONFIG_POSIX_THREAD_ATTR_STACKSIZE=y
CONFIG_POSIX_THREADS_EXT=y
CONFIG_POSIX_THREAD_PRIORITY_SCHEDULING=y
CONFIG_POSIX_PRIORITY_SCHEDULING=y
CONFIG_STATIC_INIT_GNU=y

CONFIG_NETWORKING=y
CONFIG_NET_IPV4=y
CONFIG_NET_IPV6=n
CONFIG_NET_UDP=y
CONFIG_NET_SOCKETS=y
CONFIG_NET_CONFIG_SETTINGS=y
CONFIG_NET_CONFIG_NEED_IPV4=y
CONFIG_NET_CONFIG_MY_IPV4_ADDR="127.0.0.1"
CONFIG_NET_CONFIG_PEER_IPV4_ADDR="127.0.0.1"
CONFIG_NET_CONFIG_MY_IPV4_GW=""
CONFIG_NET_CONFIG_MY_IPV4_NETMASK="255.0.0.0"
CONFIG_NET_DRIVERS=y
CONFIG_NET_LOOPBACK=y
CONFIG_NET_L2_DUMMY=y
# One local best-effort endpoint pair needs at most one 1400-byte datagram in
# each direction.  Keep two datagrams' worth of fragments plus packet slack.
CONFIG_NET_PKT_RX_COUNT=8
CONFIG_NET_PKT_TX_COUNT=8
CONFIG_NET_BUF_RX_COUNT=16
CONFIG_NET_BUF_TX_COUNT=16
CONFIG_NET_BUF_DATA_SIZE=256
CONFIG_NET_CONTEXT_NET_PKT_POOL=y
CONFIG_NET_MAX_CONTEXTS=16
CONFIG_NET_SOCKETS_POLL_MAX=16
CONFIG_NET_IF_MCAST_IPV4_ADDR_COUNT=8

CONFIG_ENTROPY_GENERATOR=y
CONFIG_LOG=y
CONFIG_LOG_MODE_IMMEDIATE=y
CONFIG_PRINTK=y
```

## boards/esp32s3_devkitc_esp32s3_procpu.overlay
```dts
&flash0 {
	reg = <0x0 DT_SIZE_M(32)>;
};

&psram0 {
	size = <DT_SIZE_M(16)>;
};
```

## src/main.c
```c
// SPDX-License-Identifier: Apache-2.0

#include <inttypes.h>
#include <stdbool.h>
#include <stdint.h>
#include <stdio.h>
#include <stdlib.h>
#include <string.h>

#include <rcl/error_handling.h>
#include <rcl/rcl.h>
#include <rclc/executor.h>
#include <rclc/rclc.h>
#include <rcutils/logging.h>
#include <ros2_zephyr/allocator.h>
#include <zephyr/kernel.h>

#include "generated_ros_init.h"
#ifdef CONFIG_ARCH_POSIX
#include "posix_board_if.h"
#endif

static volatile bool received;
static ros2_zephyr_test_msgs__msg__NestedFixed received_message;

struct thread_metrics {
  size_t count;
  size_t reserved_bytes;
};

static void report_thread(const struct k_thread *thread, void *user_data)
{
  struct thread_metrics *metrics = user_data;
  size_t unused = 0U;
  const int stack_result = k_thread_stack_space_get(thread, &unused);
  const char *name = k_thread_name_get((k_tid_t)thread);

  metrics->count++;
  metrics->reserved_bytes += thread->stack_info.size;
  printf("ROS2_ZEPHYR_STACK name=%s priority=%d reserved=%zu unused=%s",
         name != NULL && name[0] != '\0' ? name : "unnamed", k_thread_priority_get((k_tid_t)thread),
         thread->stack_info.size, stack_result == 0 ? "measured" : "unavailable");
  if (stack_result == 0) {
    printf(" unused_bytes=%zu", unused);
  }
  printf("\n");
}

static void report_threads(void)
{
  struct thread_metrics metrics = {0};
  k_thread_foreach(report_thread, &metrics);
  printf("ROS2_ZEPHYR_STACK_TOTAL threads=%zu reserved=%zu\n", metrics.count,
         metrics.reserved_bytes);
}

void subscription_callback(const void *message)
{
  received_message = *(const ros2_zephyr_test_msgs__msg__NestedFixed *)message;
  received = true;
}

static bool check(rcl_ret_t result, const char *operation)
{
  if (result == RCL_RET_OK) {
    return true;
  }
  printf("ROS2_ZEPHYR_ERROR operation=%s code=%d detail=%s\n", operation, (int)result,
         rcl_get_error_string().str);
  rcl_reset_error();
  return false;
}

int main(void)
{
  printf("ROS2_ZEPHYR_START board=%s rmw=%s middleware=%s\n", CONFIG_BOARD_TARGET,
         ROS2_ZEPHYR_RMW_NAME, ROS2_ZEPHYR_MIDDLEWARE_NAME);

  rcl_allocator_t allocator = {
      .allocate = ros2_zephyr_allocate,
      .deallocate = ros2_zephyr_deallocate,
      .reallocate = ros2_zephyr_reallocate,
      .zero_allocate = ros2_zephyr_zero_allocate,
      .state = ros2_zephyr_allocator_state(ROS2_ZEPHYR_ALLOCATION_ROS),
  };
  rclc_support_t support = {0};
  ros2z_deployment_context_t deployment = {0};
  ros2_zephyr_test_msgs__msg__NestedFixed outgoing = {0};
  bool support_initialized = false;
  bool deployment_initialized = false;
  int status = 1;

  if (!check(rclc_support_init(&support, 0, NULL, &allocator), "support_init")) {
    goto cleanup;
  }
  support_initialized = true;
  if (!check(ros2z_deployment_init(&deployment, &support, &allocator), "deployment_init")) {
    goto cleanup;
  }
  deployment_initialized = true;

  const ros2_zephyr_allocation_metrics_t ros_setup =
      ros2_zephyr_allocation_metrics(ROS2_ZEPHYR_ALLOCATION_ROS);
  const ros2_zephyr_allocation_metrics_t middleware_setup =
      ros2_zephyr_allocation_metrics(ROS2_ZEPHYR_ALLOCATION_MIDDLEWARE);
  outgoing.counter.data = UINT32_C(42424242);
  outgoing.samples.values[0] = 10U;
  outgoing.samples.values[1] = 11U;
  outgoing.samples.values[2] = 12U;
  outgoing.samples.values[3] = 13U;

  for (unsigned int attempt = 0U; attempt < 100U && !received; ++attempt) {
    if (!check(rcl_publish(&deployment.publisher_outgoing, &outgoing, NULL), "publish") ||
        !check(rclc_executor_spin_some(&deployment.executor, RCL_MS_TO_NS(20)), "spin_some")) {
      goto cleanup;
    }
    k_sleep(K_MSEC(10));
  }

  if (!received || received_message.counter.data != outgoing.counter.data ||
      memcmp(received_message.samples.values, outgoing.samples.values,
             sizeof(outgoing.samples.values)) != 0) {
    printf("ROS2_ZEPHYR_ERROR operation=loopback received=%d value=%" PRIu32 "\n", received,
           received_message.counter.data);
    goto cleanup;
  }

  printf("ROS2_ZEPHYR_LOOPBACK_PASS value=%" PRIu32 " array=%" PRIu32 ",%" PRIu32 ",%" PRIu32
         ",%" PRIu32 "\n",
         received_message.counter.data, received_message.samples.values[0],
         received_message.samples.values[1], received_message.samples.values[2],
         received_message.samples.values[3]);
  const ros2_zephyr_allocation_metrics_t ros_current =
      ros2_zephyr_allocation_metrics(ROS2_ZEPHYR_ALLOCATION_ROS);
  const ros2_zephyr_allocation_metrics_t middleware_current =
      ros2_zephyr_allocation_metrics(ROS2_ZEPHYR_ALLOCATION_MIDDLEWARE);
  printf("ROS2_ZEPHYR_ALLOC setup_ros_calls=%zu steady_ros_calls=%zu middleware=%s "
         "setup_middleware_calls=%zu steady_middleware_calls=%zu ros_high_water=%zu "
         "middleware_high_water=%zu\n",
         ros_setup.calls, ros_current.calls - ros_setup.calls, ROS2_ZEPHYR_MIDDLEWARE_NAME,
         middleware_setup.calls, middleware_current.calls - middleware_setup.calls,
         ros_current.high_water_bytes, middleware_current.high_water_bytes);
  report_threads();
  status = 0;

cleanup:
  if (deployment_initialized && ros2z_deployment_fini(&deployment) != RCL_RET_OK) {
    status = 1;
  }
  if (support_initialized && rclc_support_fini(&support) != RCL_RET_OK) {
    status = 1;
  }
  if (rcutils_logging_shutdown() != RCUTILS_RET_OK) {
    status = 1;
  }
  const ros2_zephyr_allocation_metrics_t ros_final =
      ros2_zephyr_allocation_metrics(ROS2_ZEPHYR_ALLOCATION_ROS);
  const ros2_zephyr_allocation_metrics_t middleware_final =
      ros2_zephyr_allocation_metrics(ROS2_ZEPHYR_ALLOCATION_MIDDLEWARE);
  printf("ROS2_ZEPHYR_CLEANUP status=%d ros_live=%zu middleware_live=%zu middleware=%s\n",
         status, ros_final.live_bytes, middleware_final.live_bytes,
         ROS2_ZEPHYR_MIDDLEWARE_NAME);
#ifdef CONFIG_ARCH_POSIX
  posix_exit(status);
#endif
  return status;
}
```
