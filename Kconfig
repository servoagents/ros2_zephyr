## Kconfig
```kconfig
# SPDX-License-Identifier: Apache-2.0

menuconfig ROS2_ZEPHYR
    bool "ROS 2 on Zephyr"
    default n
    help
      Build the fixed-size rclc/rcl runtime with one statically selected RMW
      backend. This configuration does not use an XRCE Agent.

if ROS2_ZEPHYR

choice ROS2_ZEPHYR_RMW_BACKEND
    prompt "RMW backend"
    default ROS2_ZEPHYR_RMW_CYCLONEDDS_C
    help
      Select exactly one middleware implementation. Applications continue to
      use the standard rclc, rcl, and RMW APIs.

config ROS2_ZEPHYR_RMW_CYCLONEDDS_C
    bool "Use rmw_cyclonedds_c"
    help
      Link rmw_cyclonedds_c and Cyclone DDS directly into the firmware.

config ROS2_ZEPHYR_RMW_ZENOH_PICO
    bool "Use rmw_zenoh_pico"
    help
      Link rmw_zenoh_pico and Zenoh-Pico directly into the firmware. The
      client connects to a Zenoh router over TCP.

endchoice

config ROS2_ZEPHYR_ZENOH_ROUTER_IPV4
    string "Zenoh router IPv4 address"
    default "127.0.0.1"
    depends on ROS2_ZEPHYR_RMW_ZENOH_PICO

config ROS2_ZEPHYR_ZENOH_ROUTER_PORT
    int "Zenoh router TCP port"
    range 1 65535
    default 7447
    depends on ROS2_ZEPHYR_RMW_ZENOH_PICO

config ROS2_ZEPHYR_ZENOH_MAX_LIVELINESS_LENGTH
    int "Maximum Zenoh liveliness key expression length"
    range 64 1024
    default 256
    depends on ROS2_ZEPHYR_RMW_ZENOH_PICO

config ROS2_ZEPHYR_DOMAIN_ID
    int "ROS domain ID"
    range 0 232
    default 95

config ROS2_ZEPHYR_CYCLONEDDS_THREAD_COUNT
    int "Maximum Cyclone DDS worker threads"
    range 5 16
    default 8 if ARCH_POSIX
    default 5
    help
      Cyclone DDS creates five mandatory workers in the supported Zephyr
      configuration. Smaller values fail during participant creation.

config ROS2_ZEPHYR_CYCLONEDDS_THREAD_STACK_SIZE
    int "Cyclone DDS worker stack size"
    range 2048 131072
    default 65536 if ARCH_POSIX
    default 8192
    help
      Stack reserved for each Cyclone DDS worker. The embedded default covers
      discovery against an external DDS peer on ESP32-S3. Applications with a
      measured local-only workload may select a smaller value.

config ROS2_ZEPHYR_GRAPH_MAX_LOCAL_NODES
    int "Maximum local nodes in one ROS graph announcement"
    range 1 16
    default 4

config ROS2_ZEPHYR_GRAPH_MAX_ENDPOINTS_PER_NODE
    int "Maximum graph endpoints associated with one node"
    range 1 32
    default 8

config ROS2_ZEPHYR_GRAPH_CACHE_MAX_PARTICIPANTS
    int "Maximum participants in the inbound ROS graph cache"
    range 1 16
    default 4

config ROS2_ZEPHYR_GRAPH_CACHE_MAX_NODES
    int "Maximum nodes in the inbound ROS graph cache"
    range 1 32
    default 8

config ROS2_ZEPHYR_GRAPH_CACHE_MAX_ENDPOINTS
    int "Maximum DDS endpoints in the inbound ROS graph cache"
    range 1 64
    default 24
    help
      DDS endpoints are retained before their ROS graph association arrives,
      so this limit must also cover temporarily unassociated endpoints.

endif
```

## project/ros2-zephyr-core/zephyr/Kconfig
```kconfig
menuconfig ROS2_ZEPHYR
    bool "ROS 2 with direct Cyclone DDS"
    default n
    help
      Build the fixed-size rclc/rcl/rmw_cyclonedds_c runtime and link it
      directly with Cyclone DDS. This configuration does not use an XRCE
      Agent.

if ROS2_ZEPHYR

config ROS2_ZEPHYR_RMW_CYCLONEDDS_C
    bool "Use rmw_cyclonedds_c"
    default y
    help
      Phase 5 currently exposes one middleware. This separate option keeps
      the module configuration extensible without pretending that multiple
      backends are implemented.

config ROS2_ZEPHYR_DOMAIN_ID
    int "ROS domain ID"
    range 0 232
    default 95

config ROS2_ZEPHYR_CYCLONEDDS_THREAD_COUNT
    int "Maximum Cyclone DDS worker threads"
    range 1 16
    default 8 if ARCH_POSIX
    default 5

config ROS2_ZEPHYR_CYCLONEDDS_THREAD_STACK_SIZE
    int "Cyclone DDS worker stack size"
    range 2048 131072
    default 65536 if ARCH_POSIX
    default 6144

endif
```

## samples/condvar_qualification/testcase.yaml
```yaml
tests:
  ros2_zephyr.condvar_qualification:
    platform_allow:
      - native_sim/native/64
      - esp32s3_devkitc/esp32s3/procpu
    integration_platforms:
      - native_sim/native/64
    tags:
      - condvar
      - kernel
```

## samples/ddsrt_native_sync/testcase.yaml
```yaml
tests:
  ros2_zephyr.ddsrt_native_sync:
    platform_allow:
      - native_sim/native/64
      - esp32s3_devkitc/esp32s3/procpu
    integration_platforms:
      - native_sim/native/64
    tags:
      - ddsrt
      - sync
```

## samples/static_control/tests/control/testcase.yaml
```yaml
tests:
  ros2_zephyr.static_control.policy:
    platform_allow:
      - native_sim/native/64
    integration_platforms:
      - native_sim/native/64
    tags:
      - static_control
      - policy
```

## samples/static_control/tests/plant/testcase.yaml
```yaml
tests:
  ros2_zephyr.static_control.plant:
    platform_allow:
      - native_sim/native/64
    tags:
      - ros2_zephyr
      - static_control
```
